## main/Kconfig.projbuild
```kconfig
menu "Desktop follow robot"
comment "One universal image: the LD2450 / NHY009 drivers are always built in, the runtime profile (auto, screen, robot) decides what starts."
config ROBOT_RADAR_RX_GPIO
    int "ESP UART RX GPIO (connect to LD2450 TX)"
    range 0 21
    default 20
config ROBOT_RADAR_TX_GPIO
    int "ESP UART TX GPIO (connect to LD2450 RX)"
    range 0 21
    default 21
config ROBOT_RADAR_BAUD
    int "LD2450 UART baud rate"
    range 9600 460800
    default 256000
config ROBOT_SERVO_GPIO
    int "NHY009 PWM GPIO"
    range 0 21
    default 10
config ROBOT_SERVO_HZ
    int "Servo PWM frequency (verify against your servo specification)"
    range 40 100
    default 50
    help
        50 Hz is an initial engineering setting, not a confirmed NHY009
        specification. PWM stays disabled at boot until 'robot arm'.
endmenu
```

## sdkconfig.defaults
```kconfig
# Target
CONFIG_IDF_TARGET="esp32c3"

# Flash 4MB（SuperMini 板载）
CONFIG_ESPTOOLPY_FLASHSIZE_4MB=y

# Wi-Fi
CONFIG_ESP_WIFI_ENABLED=y

# 网络只用 STA + IPv4 + 明文 HTTP（Hook 回键用 main/http_post.c 的普通套接字，
# OTA 与设备链路都是 HTTP/HMAC，不走 TLS）。关掉用不到的特性，体积和 RAM 都更宽裕。
# CONFIG_ESP_WIFI_SOFTAP_SUPPORT is not set
# CONFIG_ESP_WIFI_ENTERPRISE_SUPPORT is not set
# CONFIG_ESP_WIFI_ENABLE_WPA3_OWE_STA is not set
# CONFIG_ESP_WIFI_ENABLE_SAE_PK is not set
# CONFIG_ESP_WIFI_GMAC_SUPPORT is not set
# CONFIG_LWIP_IPV6 is not set
# CONFIG_LWIP_DHCPS is not set
CONFIG_MBEDTLS_TLS_DISABLED=y
# CONFIG_MBEDTLS_CERTIFICATE_BUNDLE is not set
# CONFIG_MBEDTLS_ECP_DP_BP256R1_ENABLED is not set
# CONFIG_MBEDTLS_ECP_DP_BP384R1_ENABLED is not set
# CONFIG_MBEDTLS_ECP_DP_BP512R1_ENABLED is not set
# CONFIG_MBEDTLS_ECP_DP_CURVE25519_ENABLED is not set
# CONFIG_MBEDTLS_ECP_DP_SECP192K1_ENABLED is not set
# CONFIG_MBEDTLS_ECP_DP_SECP192R1_ENABLED is not set
# CONFIG_MBEDTLS_ECP_DP_SECP224K1_ENABLED is not set
# CONFIG_MBEDTLS_ECP_DP_SECP224R1_ENABLED is not set
# CONFIG_MBEDTLS_ECP_DP_SECP256K1_ENABLED is not set
# CONFIG_MBEDTLS_PKCS7_C is not set

# Wi-Fi 缓冲和 IRAM 优化按“偶尔收一次 OTA、平时只发小 JSON”取舍，把静态 RAM 还给堆。
# 代价是 Wi-Fi 吞吐略降（关 AMPDU/IRAM 优化）；OTA 仍可用，实机已验证。
CONFIG_ESP_WIFI_STATIC_RX_BUFFER_NUM=6
CONFIG_ESP_WIFI_DYNAMIC_RX_BUFFER_NUM=16
CONFIG_ESP_WIFI_DYNAMIC_TX_BUFFER_NUM=16
# CONFIG_ESP_WIFI_AMPDU_TX_ENABLED is not set
# CONFIG_ESP_WIFI_AMPDU_RX_ENABLED is not set
# CONFIG_ESP_WIFI_IRAM_OPT is not set
# CONFIG_ESP_WIFI_RX_IRAM_OPT is not set

# NVS
CONFIG_NVS_ENCRYPTION=n

# LVGL、中文字体和 OTA：4 MB Flash 使用两个 1.7 MB 主程序槽。
# OTA 只更新主程序；中文字体位图放在固定 fontdata 分区，只随 USB 整机烧录更新。
# CONFIG_PARTITION_TABLE_SINGLE_APP is not set
# CONFIG_PARTITION_TABLE_SINGLE_APP_LARGE is not set
# CONFIG_PARTITION_TABLE_TWO_OTA_LARGE is not set
CONFIG_PARTITION_TABLE_CUSTOM=y
CONFIG_PARTITION_TABLE_CUSTOM_FILENAME="partitions_aihook.csv"

# FreeRTOS（单核 C3）
CONFIG_FREERTOS_UNICORE=y

# 日志
CONFIG_LOG_DEFAULT_LEVEL_INFO=y

# LVGL：160x80 ST7735，局部刷新配合标签循环滚动
CONFIG_LV_CONF_SKIP=y
CONFIG_LV_COLOR_DEPTH_16=y
CONFIG_LV_DEF_REFR_PERIOD=10
CONFIG_LV_USE_DRAW_SW=y
# LVGL 堆：无屏渲染测试里最重的页面（face）峰值约 30 KB，测试要求占用不超过池的 80%。
CONFIG_LV_MEM_SIZE_KILOBYTES=48
CONFIG_LV_DRAW_SW_SUPPORT_RGB565=y
CONFIG_LV_DRAW_SW_SUPPORT_RGB565_SWAPPED=y
CONFIG_LV_DRAW_SW_COMPLEX=y
# CONFIG_LV_DRAW_SW_SUPPORT_RGB565A8 is not set
# CONFIG_LV_DRAW_SW_SUPPORT_RGB888 is not set
# CONFIG_LV_DRAW_SW_SUPPORT_XRGB8888 is not set
# CONFIG_LV_DRAW_SW_SUPPORT_ARGB8888 is not set
# CONFIG_LV_DRAW_SW_SUPPORT_ARGB8888_PREMULTIPLIED is not set
# CONFIG_LV_DRAW_SW_SUPPORT_L8 is not set
# CONFIG_LV_DRAW_SW_SUPPORT_AL88 is not set
# CONFIG_LV_DRAW_SW_SUPPORT_A8 is not set
# CONFIG_LV_DRAW_SW_SUPPORT_I1 is not set
# 自定义 AI-Hook 中文字体编译在 main/aihook_font_*.c；LVGL 只保留一个很小的默认字体。
# CONFIG_LV_FONT_MONTSERRAT_10 is not set
# CONFIG_LV_FONT_MONTSERRAT_12 is not set
# CONFIG_LV_FONT_MONTSERRAT_16 is not set
# CONFIG_LV_FONT_DEFAULT_MONTSERRAT_10 is not set
# CONFIG_LV_FONT_MONTSERRAT_14 is not set
CONFIG_LV_FONT_UNSCII_8=y
CONFIG_LV_FONT_DEFAULT_UNSCII_8=y
CONFIG_LV_USE_FONT_COMPRESSED=y
# CONFIG_LV_USE_BUILTIN_SPRINTF is not set
CONFIG_LV_USE_CLIB_SPRINTF=y
# CONFIG_LV_USE_ASSERT_MALLOC is not set
# CONFIG_LV_USE_ASSERT_NULL is not set
# CONFIG_LV_USE_FONT_PLACEHOLDER is not set
# CONFIG_LV_USE_OBSERVER is not set
# CONFIG_LV_USE_THEME_DEFAULT is not set
# CONFIG_LV_USE_THEME_SIMPLE is not set
# CONFIG_LV_USE_THEME_MONO is not set
# CONFIG_LV_USE_FLEX is not set
# CONFIG_LV_USE_GRID is not set

# LVGL 只保留基础对象和 label，关闭未使用控件、示例和 demo，控制固件体积
# CONFIG_LV_USE_ANIMIMG is not set
CONFIG_LV_USE_ARC=y
# CONFIG_LV_USE_ARCLABEL is not set
# CONFIG_LV_USE_BAR is not set
# CONFIG_LV_USE_BUTTON is not set
# CONFIG_LV_USE_BUTTONMATRIX is not set
# CONFIG_LV_USE_CALENDAR is not set
# CONFIG_LV_USE_CANVAS is not set
# CONFIG_LV_USE_CHART is not set
# CONFIG_LV_USE_CHECKBOX is not set
# CONFIG_LV_USE_DROPDOWN is not set
CONFIG_LV_USE_IMAGE=y
# CONFIG_LV_USE_IMAGEBUTTON is not set
# CONFIG_LV_USE_KEYBOARD is not set
# CONFIG_LV_USE_LED is not set
# CONFIG_LV_USE_LINE is not set
# CONFIG_LV_USE_LIST is not set
# CONFIG_LV_USE_MENU is not set
# CONFIG_LV_USE_MSGBOX is not set
# CONFIG_LV_USE_ROLLER is not set
# CONFIG_LV_USE_SCALE is not set
# CONFIG_LV_USE_SLIDER is not set
# CONFIG_LV_USE_SPAN is not set
# CONFIG_LV_USE_SPINBOX is not set
# CONFIG_LV_USE_SPINNER is not set
# CONFIG_LV_USE_SWITCH is not set
# CONFIG_LV_USE_TEXTAREA is not set
# CONFIG_LV_USE_TABLE is not set
# CONFIG_LV_USE_TABVIEW is not set
# CONFIG_LV_USE_TILEVIEW is not set
# CONFIG_LV_USE_WIN is not set
# CONFIG_LV_BUILD_EXAMPLES is not set
# CONFIG_LV_BUILD_DEMOS is not set

# 1ms LVGL tick 与细粒度显示任务调度，让滚动不受 100Hz tick 限制
CONFIG_FREERTOS_HZ=1000

# OTA 下载新主程序后，首次启动成功才确认，启动失败时允许回滚到旧槽位。
CONFIG_BOOTLOADER_APP_ROLLBACK_ENABLE=y

# 关闭 unity（节省 flash；逻辑已测过）
CONFIG_COMPILER_OPTIMIZATION_SIZE=y

# GPIO20/21 are used by the robot UART1. Keep application console logs on USB;
# ROM boot messages may still appear on GPIO21 before firmware starts.
CONFIG_ESP_CONSOLE_USB_SERIAL_JTAG=y
# CONFIG_ESP_CONSOLE_UART_DEFAULT is not set
# CONFIG_ESP_CONSOLE_UART_CUSTOM is not set
CONFIG_ESP_CONSOLE_SECONDARY_NONE=y
```
