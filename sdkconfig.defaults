## sdkconfig.defaults
```kconfig
# Target
CONFIG_IDF_TARGET="esp32c3"

# Flash 4MB（SuperMini 板载）
CONFIG_ESPTOOLPY_FLASHSIZE_4MB=y

# Wi-Fi
CONFIG_ESP_WIFI_ENABLED=y

# NVS
CONFIG_NVS_ENCRYPTION=n

# LVGL、中文字体和 OTA：4 MB Flash 使用两个 1.7 MB 主程序槽。
# OTA 只更新主程序；中文字体位图放在固定 fontdata 分区，只随 USB 整机烧录更新。
# CONFIG_PARTITION_TABLE_SINGLE_APP is not set
# CONFIG_PARTITION_TABLE_SINGLE_APP_LARGE is not set
# CONFIG_PARTITION_TABLE_TWO_OTA_LARGE is not set
CONFIG_PARTITION_TABLE_CUSTOM=y
CONFIG_PARTITION_TABLE_CUSTOM_FILENAME="partitions_aihook.csv"

# FreeRTOS（单核 C3）
CONFIG_FREERTOS_UNICORE=y

# 日志
CONFIG_LOG_DEFAULT_LEVEL_INFO=y

# LVGL：160x80 ST7735，局部刷新配合标签循环滚动
CONFIG_LV_CONF_SKIP=y
CONFIG_LV_COLOR_DEPTH_16=y
CONFIG_LV_DEF_REFR_PERIOD=10
CONFIG_LV_USE_DRAW_SW=y
CONFIG_LV_DRAW_SW_SUPPORT_RGB565=y
CONFIG_LV_DRAW_SW_SUPPORT_RGB565_SWAPPED=y
CONFIG_LV_DRAW_SW_COMPLEX=y
# CONFIG_LV_DRAW_SW_SUPPORT_RGB565A8 is not set
# CONFIG_LV_DRAW_SW_SUPPORT_RGB888 is not set
# CONFIG_LV_DRAW_SW_SUPPORT_XRGB8888 is not set
# CONFIG_LV_DRAW_SW_SUPPORT_ARGB8888 is not set
# CONFIG_LV_DRAW_SW_SUPPORT_ARGB8888_PREMULTIPLIED is not set
# CONFIG_LV_DRAW_SW_SUPPORT_L8 is not set
# CONFIG_LV_DRAW_SW_SUPPORT_AL88 is not set
# CONFIG_LV_DRAW_SW_SUPPORT_A8 is not set
# CONFIG_LV_DRAW_SW_SUPPORT_I1 is not set
# 自定义 AI-Hook 中文字体编译在 main/aihook_font_*.c；LVGL 只保留一个很小的默认字体。
# CONFIG_LV_FONT_MONTSERRAT_10 is not set
# CONFIG_LV_FONT_MONTSERRAT_12 is not set
# CONFIG_LV_FONT_MONTSERRAT_16 is not set
# CONFIG_LV_FONT_DEFAULT_MONTSERRAT_10 is not set
# CONFIG_LV_FONT_MONTSERRAT_14 is not set
CONFIG_LV_FONT_UNSCII_8=y
CONFIG_LV_FONT_DEFAULT_UNSCII_8=y
# CONFIG_LV_USE_BUILTIN_SPRINTF is not set
CONFIG_LV_USE_CLIB_SPRINTF=y
# CONFIG_LV_USE_ASSERT_MALLOC is not set
# CONFIG_LV_USE_ASSERT_NULL is not set
# CONFIG_LV_USE_FONT_PLACEHOLDER is not set
# CONFIG_LV_USE_OBSERVER is not set
# CONFIG_LV_USE_THEME_DEFAULT is not set
# CONFIG_LV_USE_THEME_SIMPLE is not set
# CONFIG_LV_USE_THEME_MONO is not set
# CONFIG_LV_USE_FLEX is not set
# CONFIG_LV_USE_GRID is not set

# LVGL 只保留基础对象和 label，关闭未使用控件、示例和 demo，控制固件体积
# CONFIG_LV_USE_ANIMIMG is not set
# CONFIG_LV_USE_ARC is not set
# CONFIG_LV_USE_ARCLABEL is not set
# CONFIG_LV_USE_BAR is not set
# CONFIG_LV_USE_BUTTON is not set
# CONFIG_LV_USE_BUTTONMATRIX is not set
# CONFIG_LV_USE_CALENDAR is not set
# CONFIG_LV_USE_CANVAS is not set
# CONFIG_LV_USE_CHART is not set
# CONFIG_LV_USE_CHECKBOX is not set
# CONFIG_LV_USE_DROPDOWN is not set
# CONFIG_LV_USE_IMAGE is not set
# CONFIG_LV_USE_IMAGEBUTTON is not set
# CONFIG_LV_USE_KEYBOARD is not set
# CONFIG_LV_USE_LED is not set
# CONFIG_LV_USE_LINE is not set
# CONFIG_LV_USE_LIST is not set
# CONFIG_LV_USE_MENU is not set
# CONFIG_LV_USE_MSGBOX is not set
# CONFIG_LV_USE_ROLLER is not set
# CONFIG_LV_USE_SCALE is not set
# CONFIG_LV_USE_SLIDER is not set
# CONFIG_LV_USE_SPAN is not set
# CONFIG_LV_USE_SPINBOX is not set
# CONFIG_LV_USE_SPINNER is not set
# CONFIG_LV_USE_SWITCH is not set
# CONFIG_LV_USE_TEXTAREA is not set
# CONFIG_LV_USE_TABLE is not set
# CONFIG_LV_USE_TABVIEW is not set
# CONFIG_LV_USE_TILEVIEW is not set
# CONFIG_LV_USE_WIN is not set
# CONFIG_LV_BUILD_EXAMPLES is not set
# CONFIG_LV_BUILD_DEMOS is not set

# 1ms LVGL tick 与细粒度显示任务调度，让滚动不受 100Hz tick 限制
CONFIG_FREERTOS_HZ=1000

# OTA 下载新主程序后，首次启动成功才确认，启动失败时允许回滚到旧槽位。
CONFIG_BOOTLOADER_APP_ROLLBACK_ENABLE=y

# 关闭 unity（节省 flash；逻辑已测过）
CONFIG_COMPILER_OPTIMIZATION_SIZE=y
```
